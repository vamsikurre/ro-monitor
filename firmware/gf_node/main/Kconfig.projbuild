## firmware/gf_node/main/Kconfig.projbuild
```kconfig
menu "Ground-floor node"

    choice GF_ROLE
        prompt "Role"
        default GF_ROLE_SUMP
        config GF_ROLE_SUMP
            bool "Sump level node 0x05"
        config GF_ROLE_UTILITY
            bool "Utility room node 0x06"
    endchoice

    config GF_WIFI_SSID
        string "Wi-Fi SSID"
        default "changeme"
    config GF_WIFI_PASS
        string "Wi-Fi password"
        default "changeme"
    config GF_STATIC_IP
        string "Static IP (what you type on the hub's /cal)"
        default "192.168.1.51"
    config GF_GATEWAY
        string "Gateway"
        default "192.168.1.1"
    config GF_NETMASK
        string "Netmask"
        default "255.255.255.0"
    config GF_FLOAT_LOW_LEVEL
        int "GPIO 26 level that means the sump float is LOW (utility node)"
        range 0 1
        default 0
        help
            The PC817 pulls GPIO 26 low when the float loop is closed. 0 = opto
            on means sump low; set 1 if the float is wired the other way round.
    config GF_CTL_TOKEN
        string "Control token (pump commands, config push, OTA)"
        default ""
        help
            Must match the token on the hub's /cal (utility node) and the
            X-Ctl-Token header of an OTA push (both roles). Empty means every
            command, config push and OTA upload is refused: USB flashing only.
            Set it in build_<role>/sdkconfig, never in the tracked
            sdkconfig.util or sdkconfig.defaults.
endmenu
```
